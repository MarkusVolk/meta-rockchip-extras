## conf/layer.conf
```bitbake
# We have a conf and classes directory, add to BBPATH
BBPATH .= ":${LAYERDIR}"

# We have recipes-* directories, add to BBFILES
BBFILES += "${LAYERDIR}/recipes-*/*/*.bb ${LAYERDIR}/recipes-*/*/*.bbappend"

BBFILE_COLLECTIONS += "rockchip-extras"
BBFILE_PATTERN_rockchip-extras = "^${LAYERDIR}/"
BBFILE_PRIORITY_rockchip-extras = "7"

# This should only be incremented on significant changes that will
# cause compatibility issues with other layers
LAYERVERSION_rockchip-extras = "1"
LAYERSERIES_COMPAT_rockchip-extras = "honister"
LAYERDEPENDS_rockchip-extras = "core"
LICENSE_PATH += "${LAYERDIR}/files/custom-licenses"
```

## conf/machine/rock-pi-4b-plus.conf
```bitbake
#@TYPE: Machine
#@NAME: Rock Pi 4B Plus RK3399
#@DESCRIPTION: Rock Pi 4 is a Raspberry Pi 4 Alternative based on Rockchip RK3399 Processor.
#
# NOTE: This machine is for Kernel 5.10 and later. If you are using an older
# kernel, see rock-pi-4.conf

require conf/machine/include/rock-pi-4.inc

KERNEL_DEVICETREE = "rockchip/rk3399-rock-pi-4b-plus.dtb"
UBOOT_MACHINE = "rock-pi-4-rk3399_defconfig"
```
